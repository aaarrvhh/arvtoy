## meta-aaarrv/conf/layer.conf
```bitbake
# We have a conf and classes directory, add to BBPATH
BBPATH .= ":${LAYERDIR}"

# We have recipes-* directories, add to BBFILES
# BBFILES += "${LAYERDIR}/recipes-*/*/*.bb \
#            ${LAYERDIR}/recipes-*/*/*.bbappend"

BBFILE_COLLECTIONS += "aaarrv-layer"
BBFILE_PATTERN_aaarrv-layer := "^${LAYERDIR}/"
LAYERSERIES_COMPAT_aaarrv-layer = "warrior zeus dunfell"
```

## meta-aaarrv/meta-aaarrv-npcm750/conf/layer.conf
```bitbake
# We have a conf and classes directory, add to BBPATH
BBPATH .= ":${LAYERDIR}"

# We have recipes-* directories, add to BBFILES
# BBFILES += "${LAYERDIR}/recipes-*/*/*.bb \
#            ${LAYERDIR}/recipes-*/*/*.bbappend"

BBFILE_COLLECTIONS += "aaarrv-npcm750-layer"
BBFILE_PATTERN_aaarrv-npcm750-layer := "^${LAYERDIR}/"
LAYERSERIES_COMPAT_aaarrv-npcm750-layer = "warrior zeus dunfell"
```
